## dt_power_hil/firmware/esp32_edge_guard/main/Kconfig.projbuild
```kconfig
menu "edge_guard"
    config BROKER_URI
        string "MQTT broker URI (isolated bench LAN)"
        default "mqtt://192.168.50.10"
endmenu
```
